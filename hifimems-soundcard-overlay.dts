// Simple driver for Hifiberry and ICS43432 MEMS microphone compatible hardware
/dts-v1/;
/plugin/;

/ {
	compatible = "brcm,bcm2708";

	fragment@0 {
		target = <&i2s>;
		__overlay__ {
			status = "okay";
		};
	};

	fragment@2 {
		target-path = "/";
		__overlay__ {
			hifimems-codec {
				#sound-dai-cells = <0>;
				compatible = "hifimems,hifimems";
				status = "okay";
			};
		};
	};

	fragment@3 {
		target = <&sound>;
		__overlay__ {
			compatible = "hifimems,hifimems-soundcard";
			i2s-controller = <&i2s>;
			status = "okay";
		};
	};
};
